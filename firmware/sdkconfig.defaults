## firmware/sdkconfig.defaults
```kconfig
CONFIG_IDF_TARGET="esp32p4"
CONFIG_ESPTOOLPY_FLASHMODE_QIO=y
CONFIG_ESPTOOLPY_FLASHSIZE_16MB=y
CONFIG_PARTITION_TABLE_CUSTOM=y
CONFIG_PARTITION_TABLE_OFFSET=0x10000
CONFIG_COMPILER_OPTIMIZATION_PERF=y
CONFIG_SPIRAM=y
CONFIG_SPIRAM_SPEED_200M=y
CONFIG_ESP_MAIN_TASK_STACK_SIZE=10240
CONFIG_FREERTOS_HZ=1000
CONFIG_LV_USE_CLIB_MALLOC=y
CONFIG_LV_USE_CLIB_STRING=y
CONFIG_LV_USE_CLIB_SPRINTF=y
CONFIG_LV_DEF_REFR_PERIOD=16
CONFIG_LV_OS_FREERTOS=y
CONFIG_LV_DRAW_SW_DRAW_UNIT_CNT=4
CONFIG_LV_USE_OBSERVER=y
CONFIG_LV_USE_SCALE=y
CONFIG_LV_USE_ARC=y
CONFIG_LV_USE_FLEX=y
CONFIG_LV_USE_IMAGE=y
CONFIG_LV_USE_OBJ_NAME=y
CONFIG_LV_USE_FLOAT=y
CONFIG_LV_COLOR_DEPTH_16=y
CONFIG_BSP_LCD_COLOR_FORMAT_RGB565=y
CONFIG_BSP_LCD_TYPE_1024_600=y
CONFIG_BSP_LCD_DPI_BUFFER_NUMS=2
CONFIG_BSP_LCD_USE_DMA2D=n
CONFIG_BSP_DISPLAY_LVGL_AVOID_TEAR=y
CONFIG_BSP_DISPLAY_LVGL_FULL_REFRESH=y
CONFIG_LV_USE_DRAW_SW_ASM=0
CONFIG_IDF_EXPERIMENTAL_FEATURES=y
```
